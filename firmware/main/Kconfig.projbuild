## firmware/main/Kconfig.projbuild
```kconfig
menu "ESP32-CAN-X2 diagnostics"
    choice CANX2_MODE
        prompt "CAN diagnostic source"
        default CANX2_MODE_LIVE
        config CANX2_MODE_LIVE
            bool "Physical CAN1 (normal mode with hardware ACK)"
        config CANX2_MODE_SYNTHETIC
            bool "Software-generated Haltech test frames (CAN1 disabled)"
    endchoice

    config CANX2_GEAR_ECHO
        bool "Allow serial control of the 0x650 GearEcho diagnostic"
        depends on CANX2_MODE_LIVE
        depends on ESP_CONSOLE_UART_DEFAULT || ESP_CONSOLE_UART_CUSTOM || ESP_CONSOLE_USB_SERIAL_JTAG
        default y
        help
            Start receive-only and accept "gear-echo on" and "gear-echo off"
            on the primary serial console. When enabled, echo at up to 5 Hz.

    config CANX2_SPEED_SCALE_NUMERATOR
        int "Vehicle speed scale numerator (km/h)"
        range 1 1000000
        default 1

    config CANX2_SPEED_SCALE_DENOMINATOR
        int "Vehicle speed scale denominator (km/h)"
        range 1 1000000
        default 10

    config CANX2_RAW_LOG
        bool "Print every physical CAN frame (high log volume)"
        default n
endmenu
```
